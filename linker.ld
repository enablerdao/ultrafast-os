/* Ultra Fast OS リンカスクリプト */

ENTRY(_start)  /* エントリーポイントの指定 */

SECTIONS {
    /* カーネルは0x1000:0x1000 (物理アドレス 0x11000) にロードされる */
    . = 0x11000;

    .text : {
        *(.text)        /* すべてのテキストセクション */
    }

    .rodata : {
        *(.rodata)      /* すべての読み取り専用データセクション */
    }

    .data : {
        *(.data)        /* すべてのデータセクション */
    }

    .bss : {
        *(.bss)         /* すべての未初期化データセクション */
    }
}